#include <M5StickC.h>
#include <pgmspace.h>

constexpr int LOGO_WIDTH = 48;
constexpr int LOGO_HEIGHT = 72;
static const uint8_t logoBitmap[] PROGMEM = {
    0x00, 0x00, 0x07, 0xFC, 0x00, 0x00, 0x00, 0x00, 0x3B, 0x03, 0x80, 0x00,
    0x00, 0x00, 0x60, 0x08, 0xC0, 0x00, 0x00, 0x00, 0x80, 0x30, 0x20, 0x00,
    0x00, 0x03, 0x00, 0x20, 0x10, 0x00, 0x00, 0x04, 0x00, 0x20, 0x3C, 0x00,
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    0x00, 0x00, 0x03, 0xFF, 0xE0, 0x00, 0x00, 0x00, 0x00, 0x00, 0x00, 0x00,
};

const char *const MONTH_NAMES[] = {
    "JAN", "FEB", "MAR", "APR", "MAY", "JUN",
    "JUL", "AUG", "SEP", "OCT", "NOV", "DEC"};

void drawLogo() {
  constexpr int logoX = 108;
  constexpr int logoY = 4;
  M5.Lcd.fillRect(logoX, logoY, LOGO_WIDTH, LOGO_HEIGHT, TFT_WHITE);

  const int bytesPerRow = (LOGO_WIDTH + 7) / 8;
  for (int y = 0; y < LOGO_HEIGHT; ++y) {
    for (int x = 0; x < LOGO_WIDTH; ++x) {
      const uint8_t bits =
          pgm_read_byte(&logoBitmap[y * bytesPerRow + x / 8]);
      if (bits & (0x80 >> (x & 7))) {
        M5.Lcd.drawPixel(logoX + x, logoY + y, TFT_BLACK);
      }
    }
  }
}

// Arizona observes MST year-round, so convert the RTC's UTC reading by -7 hours.
RTC_DateTypeDef arizonaDate = {};
int arizonaHour = 0;
int arizonaMinute = 0;

bool isLeapYear(int year) {
  return year % 4 == 0 && (year % 100 != 0 || year % 400 == 0);
}

int daysInMonth(int month, int year) {
  static const int days[] = {31, 28, 31, 30, 31, 30,
                             31, 31, 30, 31, 30, 31};
  if (month == 2 && isLeapYear(year)) {
    return 29;
  }
  return days[month - 1];
}

void readArizonaTime() {
  M5.Rtc.GetBm8563Time();

  RTC_DateTypeDef utcDate = {};
  M5.Rtc.GetData(&utcDate);
  arizonaDate = utcDate;
  arizonaHour = static_cast<int>(M5.Rtc.Hour) - 7;
  arizonaMinute = M5.Rtc.Minute;

  if (arizonaHour < 0) {
    arizonaHour += 24;
    if (--arizonaDate.Date < 1) {
      if (--arizonaDate.Month < 1) {
        arizonaDate.Month = 12;
        --arizonaDate.Year;
      }
      arizonaDate.Date = daysInMonth(arizonaDate.Month, arizonaDate.Year);
    }
  }
}

void drawDate() {
  char dateText[16];
  const int month = constrain(arizonaDate.Month, 1, 12);
  snprintf(dateText, sizeof(dateText), "%s %02d %02d",
           MONTH_NAMES[month - 1], arizonaDate.Date, arizonaDate.Year % 100);

  M5.Lcd.fillRect(7, 57, 96, 19, TFT_BLACK);
  M5.Lcd.setTextColor(TFT_WHITE, TFT_BLACK);
  M5.Lcd.setTextFont(2);
  M5.Lcd.setCursor(8, 59);
  M5.Lcd.print(dateText);
}

void drawTime() {
  int hour = arizonaHour % 12;
  if (hour == 0) {
    hour = 12;
  }

  char timeText[6];
  snprintf(timeText, sizeof(timeText), "%02d:%02d", hour, arizonaMinute);

  M5.Lcd.fillRect(7, 24, 96, 32, TFT_BLACK);
  M5.Lcd.setTextColor(TFT_WHITE, TFT_BLACK);
  M5.Lcd.setTextFont(4);
  M5.Lcd.setCursor(8, 27);
  M5.Lcd.print(timeText);

  M5.Lcd.setTextFont(2);
  M5.Lcd.setCursor(77, 43);
  M5.Lcd.print(arizonaHour < 12 ? "AM" : "PM");
}

void setup() {
  M5.begin();
  M5.Lcd.setRotation(3);
  M5.Lcd.fillScreen(TFT_BLACK);

  readArizonaTime();

  M5.Lcd.drawFastVLine(104, 5, 70, TFT_WHITE);

  drawLogo();
  drawTime();
  drawDate();
}

void loop() {
  static int lastHour = -1;
  static int lastMinute = -1;
  static int lastDate = -1;
  static int lastMonth = -1;
  static int lastYear = -1;

  readArizonaTime();

  if (arizonaHour != lastHour || arizonaMinute != lastMinute) {
    drawTime();
    lastHour = arizonaHour;
    lastMinute = arizonaMinute;
  }

  if (arizonaDate.Date != lastDate || arizonaDate.Month != lastMonth ||
      arizonaDate.Year != lastYear) {
    drawDate();
    lastDate = arizonaDate.Date;
    lastMonth = arizonaDate.Month;
    lastYear = arizonaDate.Year;
  }

  delay(250);
}
